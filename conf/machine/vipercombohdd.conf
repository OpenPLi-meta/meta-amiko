## conf/machine/vipercombohdd.conf
```bitbake
#@TYPE: Machine
#@NAME: Viper Combo HDD
#@DESCRIPTION: Machine configuration for the Viper Combo HDD

SOC_FAMILY = "bcm73625"
CHIPSET = "bcm73625"

BRAND_OEM = "amiko"
MACHINE_BRAND = "AMIKO"
MACHINE_NAME = "Viper Combo HDD"

MKUBIFS_ARGS = "-m 2048 -e 126976 -c 4096"
UBINIZE_ARGS = "-m 2048 -p 128KiB -s 2048"

MTD_KERNEL = "mtd2"
MTD_ROOTFS = "mtd0"
KERNEL_FILE = "kernel.bin"
ROOTFS_FILE = "rootfs.bin"

MACHINE_FEATURES += " textlcd 7segment dvb-c hdmicec skins1080 ci RCA HDMI TIMERWAKEUP"

DVBMEDIASINK_CONFIG_append = " --with-h265 --with-vb6 --with-vb8 --with-spark"

RCTYPE = "18"

require conf/machine/include/amiko.inc
```
